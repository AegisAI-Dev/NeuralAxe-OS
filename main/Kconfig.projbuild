## main/Kconfig.projbuild
```kconfig
menu "Bitaxe Configuration"

    menu "GPIO Pin Configuration"

        config GPIO_BUTTON_BOOT
            int "Boot button GPIO pin"
            default 0
            help
                GPIO pin connected to the BOOT button.

        config GPIO_ASIC_RESET
            int "ASIC reset GPIO pin"
            default 1
            help
                GPIO pin for ASIC_RESET (RST_N), reset input to ASIC.

        config GPIO_ASIC_ENABLE
            int "ASIC enable GPIO pin"
            default 10
            help
                GPIO pin for ASIC_ENABLE (POWER_EN), enable for core power supply.

        config GPIO_PLUG_SENSE
            int "Barrel plug sense GPIO pin"
            default 12
            help
                GPIO pin for DC barrel (PLUG_SENSE), sense pin of DC power jack socket.

        config GPIO_I2C_SDA
            int "I2C SDA Pin"
            default 47
            help
                GPIO pin for I2C clock line (SDA).
            
        config GPIO_I2C_SCL
            int "I2C SCL Pin"
            default 48
            help
                GPIO pin for I2C clock line (SCL).
        config GPIO_BAP_RX
            int "I2C BAP Pin"
            default 40
            help
                GPIO pin for BAP receiving line.
        config GPIO_BAP_TX
            int "I2C BAP Pin"
            default 39
            help
                GPIO pin for BAP transmitting line.
            
    endmenu
    
    config ASIC_VOLTAGE
        int "ASIC Core Voltage (mV)"
        range 1000 1800
        default 1400
        help
            The core voltage to set the ASIC to. 1200 for BM1366 or 1400 for BM1397 is typical.

    config ASIC_FREQUENCY
        int "ASIC Hash Frequency (MHz)"
        range 50 800
        default 250
        help
            The BM1397 hash frequency
endmenu

menu "Stratum Configuration"

    config STRATUM_URL
        string "Stratum Address"
        default "public-pool.io"
        help
            The example will connect to this Stratum pool address.

    config STRATUM_PORT
        int "Stratum Port"
        range 0 65535
        default 21496
        help
            The stratum server port to connect to.
    
    choice
        prompt "Stratum TLS mode"
        default STRATUM_TLS_DISABLED
        help
            Select how TLS is used for stratum connections.

        config STRATUM_TLS_DISABLED
            bool "Disabled"

        config STRATUM_TLS_BUNDLED
            bool "Enabled (bundled CA certificate)"

        config STRATUM_TLS_CUSTOM
            bool "Enabled (user-provided/custom CA certificate)"
    endchoice

    config STRATUM_TLS
        int
        default 0 if STRATUM_TLS_DISABLED
        default 1 if STRATUM_TLS_BUNDLED
        default 2 if STRATUM_TLS_CUSTOM
    
    config STRATUM_CERT
        string "Stratum Certificate"
        default "x"
        help
            The certificate to use with the stratum connection.

    config EXTRANONCE_SUBSCRIBE
        bool "Pool extranonce subscribe"
        default n
        help
            Enable stratum extranonce subscribe.

    config FALLBACK_STRATUM_URL
        string "Fallback Stratum Address"
        default "solo.ckpool.org"
        help
            The example will connect to this Stratum pool address if the primary fails.

    config FALLBACK_STRATUM_PORT
        int "Fallback Stratum Port"
        range 0 65535
        default 3333
        help
            The stratum server port to connect to if the primary fails.
    
    choice
        prompt "Fallback Stratum TLS mode"
        default FALLBACK_STRATUM_TLS_DISABLED
        help
            Select how TLS is used for stratum connections.

        config FALLBACK_STRATUM_TLS_DISABLED
            bool "Disabled"

        config FALLBACK_STRATUM_TLS_BUNDLED
            bool "Enabled (bundled CA certificate)"

        config FALLBACK_STRATUM_TLS_CUSTOM
            bool "Enabled (user-provided/custom CA certificate)"
    endchoice

    config FALLBACK_STRATUM_TLS
        int
        default 0 if FALLBACK_STRATUM_TLS_DISABLED
        default 1 if FALLBACK_STRATUM_TLS_BUNDLED
        default 2 if FALLBACK_STRATUM_TLS_CUSTOM
    
    config FALLBACK_STRATUM_CERT
        string "Fallback Stratum Certificate"
        default "x"
        help
            The certificate to use with the stratum connection if the primary fails.

    config FALLBACK_EXTRANONCE_SUBSCRIBE
        bool "Fallback pool extranonce subscribe"
        default n
        help
            Enable fallback pool extranonce subscribe.

    config STRATUM_USER
        string "Stratum username"
        default "replace-this-with-your-btc-address.bitaxe"
        help
            Stratum user to use with pool

    config STRATUM_PW
        string "Stratum password"
        default "x"
        help
            Stratum password to use with pool

    config FALLBACK_STRATUM_USER
        string "Fallback Stratum username"
        default "replace-this-with-your-btc-address.bitaxe"
        help
            Fallback Stratum user to use with pool

    config FALLBACK_STRATUM_PW
        string "Fallback Stratum password"
        default "x"
        help
            Fallback Stratum password to use with pool

    config STRATUM_DIFFICULTY
        int "Stratum default difficulty"
        range 0 4294967296
        default 1000
        help
            A starting difficulty to use with the pool.

    config FALLBACK_STRATUM_DIFFICULTY
        int "Fallback stratum default difficulty"
        range 0 4294967296
        default 1000
        help
            A starting difficulty to use with the fallback pool.

    config ENABLE_TASK_MONITOR
        bool "Task Monitor"
        default n
        help
            Enable task monitor. NOTE: This is intended for debugging use only as the use of uxTaskGetSystemState results in the scheduler remaining suspended for an extended period.

    config NX_TIMED_SESSIONS
        bool "NeuralAxe timed pool sessions (EXPERIMENTAL, board 601 / BM1370 only)"
        default n
        help
            EXPERIMENTAL. Enables device-side unattended timed pool sessions
            (NeuralAxe Phase 2M.1B). Board 601 / BM1370 only. Disabled by default.

            Gate B6 is the first gate that wires runtime behavior to this flag: it
            loads the persisted session store during boot, plans boot recovery,
            bootstraps the single operation coordinator and HOLDS protocol/Stratum
            startup for every unresolved session posture. It still performs NO pool
            configuration change, NO restoration, NO Stratum control, NO target
            mining authorization, NO OTA and NO restart - those belong to Gate B7.

            With the flag disabled nothing changes: no runtime instance, no runtime
            task, the nx_tps namespace is never opened, SNTP is never initialized and
            protocol startup is unchanged. Leave disabled for production until the
            later gates integrate controlled apply, restore and the API.

    config NX_TIMED_SESSIONS_NTP_SERVER
        string "Trusted-time (SNTP) server for timed pool sessions"
        depends on NX_TIMED_SESSIONS
        default ""
        help
            Product-configured SNTP server used ONLY to establish trusted time for
            timed pool session deadlines after a reboot.

            DELIBERATELY EMPTY BY DEFAULT. No public NTP hostname is baked into the
            firmware. While this is empty the runtime reports an unconfigured time
            source and keeps protocol startup HELD whenever boot recovery requires
            trusted time - it never invents trust and never contacts a server that
            the product has not explicitly chosen. Selecting a server is an open
            product decision (privacy, availability and jurisdiction).

            Accepted values (Gate B10 bounded validation): a dotted DNS hostname
            of at least two labels drawn only from [A-Za-z0-9.-], or a dotted-quad
            IPv4 literal without leading zeros. URL schemes, paths, credentials,
            whitespace, control characters, single-label names and IPv6 literals
            are rejected, and a rejected value behaves exactly like an empty one:
            no DNS lookup and no SNTP start ever happen.

            Note: standard SNTP/DNS is not cryptographically authenticated (no NTS,
            no DNSSEC). See components/pool_time/include/pool_time.h for the exact
            trust boundary and the documented network-trust residual.

    config NX_TIMED_SESSIONS_TIME_OBSERVE
        bool "Timed pool session trusted-time OBSERVATION only (EXPERIMENTAL, Gate B10)"
        depends on NX_TIMED_SESSIONS
        default n
        help
            EXPERIMENTAL. Starts the trusted-time (SNTP) provider after network
            readiness purely to OBSERVE and validate trusted time on a real device,
            so a supervised pilot can confirm the time foundation before any timed
            session is ever created. Board 601 / BM1370 only. Disabled by default.

            This is a FOURTH, independent safety flag and it authorizes NOTHING.
            With it enabled the device still creates no session, applies no target
            pool configuration, restores nothing, acquires no operation lease,
            writes no session record, commits no heartbeat, changes no ASIC gate,
            grants no target mining and never restarts. It does not require the
            Gate B7 execution flag or the Gate B8 API flag, and it never turns an
            empty session store into a session store.

            Observation runs only on a device with NO session owner: an empty or
            cleared store. Normal source/default mining and protocol startup are
            byte-for-byte unchanged whether the synchronization succeeds, times
            out or never starts because no source is configured.

            With CONFIG_NX_TIMED_SESSIONS_NTP_SERVER empty no network request is
            made at all and the status simply reports an unconfigured source.

    config NX_TIMED_SESSIONS_TIME_OBSERVE_PILOT_DIAGNOSTICS
        bool "Timed pool session observation-pilot diagnostics (EXPERIMENTAL, Gate B10.1)"
        depends on NX_TIMED_SESSIONS_TIME_OBSERVE
        default n
        help
            EXPERIMENTAL. Adds bounded, read-only serial diagnostics for a
            supervised trusted-time OBSERVATION pilot, so the owner can watch a
            real device without a dashboard, without an HTTP route and without
            enabling the Gate B8 API. Board 601 / BM1370 only. Disabled by
            default and never auto-enabled.

            This is a FIFTH, independent safety flag and it authorizes NOTHING.
            It only observes already-published bounded facts on the single Gate
            B6 owner task and writes bounded machine-token log lines: the
            trusted-time source lifecycle, network/link readiness, the
            observation summary, and an invariant report of the healthy
            empty-store posture. It creates no task, registers no event
            handler, opens no socket, writes no nx_tps key, changes no public
            schema,
            never runs from an interrupt and never holds a lock across a log
            call or an external call.

            A detected invariant violation is REPORTED, never acted upon: it
            never restarts the device, clears a record, changes the pool
            configuration or stops mining. Acting on it is the owner's decision.

            No log line can carry the configured trusted-time hostname, a
            resolved address, a raw wall-clock epoch, a pool identity, an
            account, a worker, a password, a session identifier, a lease token
            or a record generation - the diagnostic models have no string field
            and the formatters accept no string input.

            With this flag disabled the firmware is byte-for-byte the committed
            Gate B10 build: no pilot symbol is linked and no pilot line is
            emitted. Leave disabled for production; enable it only for an
            owner-built, owner-flashed pilot artifact.

    config NX_TIMED_SESSIONS_STORE_PREFLIGHT
        bool "Timed pool session READ-ONLY store preflight (EXPERIMENTAL, Gate B10.2)"
        depends on !NX_TIMED_SESSIONS && !NX_TIMED_SESSIONS_EXECUTION && \
                   !NX_TIMED_SESSIONS_API && !NX_TIMED_SESSIONS_TIME_OBSERVE && \
                   !NX_TIMED_SESSIONS_TIME_OBSERVE_PILOT_DIAGNOSTICS
        default n
        help
            EXPERIMENTAL. Performs EXACTLY ONE strictly read-only inspection of
            the timed-session NVS namespace during boot and reports a single
            bounded classification token on the serial console. Board 601 /
            BM1370 only. Disabled by default and never auto-enabled.

            WHY IT EXISTS. Gate B10.1 established that the timed-session store
            could not be classified before flashing an observation-pilot image:
            the only sanitized read surface is the Gate B8 API that a pilot
            build must keep disabled, and the only alternative was dumping the
            whole NVS partition, which carries Wi-Fi and pool credentials.

            This flag does NOT REQUIRE NX_TIMED_SESSIONS: the store and record
            components compile unconditionally, so the preflight reads the
            committed schema without bringing the timed-session runtime into
            existence. No runtime instance, no owner task, no operation
            coordinator, no recovery plan, no SNTP.

            It is MUTUALLY EXCLUSIVE with NX_TIMED_SESSIONS ITSELF and with
            timed-session execution, the control API, trusted-time observation
            and pilot diagnostics. The parent flag matters as much as its
            children: the four sub-flags all depend on NX_TIMED_SESSIONS, so
            excluding only them would still allow NX_TIMED_SESSIONS=y, and the
            Gate B6 bootstrap would then open nx_tps with NVS_READWRITE on the
            same boot - CREATING the very namespace this posture exists to
            inspect without creating. A C-level #error enforces the same rule.

            The inspection opens ONE namespace with NVS_READONLY, which per
            ESP-IDF never creates it, and drives the committed Gate B3 loader
            through an operations table whose write and commit entries are
            unconditional refusals that count the attempt. No nvs_set_*, no
            nvs_erase_*, no nvs_commit exists on any path, and the classifier
            fails closed if a counter is ever non-zero.

            Only TPS_PREFLIGHT_EMPTY and TPS_PREFLIGHT_CLEARED permit a later
            pilot. Unknown, truncated or corrupt data can never produce either.
            No log line carries a namespace, key name, record size, generation,
            session id, trusted epoch, pool identity, credential, raw payload
            or NVS error string.

            With this flag disabled no preflight symbol is linked, no NVS read
            occurs and no token is emitted. Leave disabled for production.

    config NX_TIMED_SESSIONS_EXECUTION
        bool "Timed pool session controlled execution (EXPERIMENTAL, Gate B7)"
        depends on NX_TIMED_SESSIONS
        default n
        help
            EXPERIMENTAL. Enables the Gate B7 controlled-execution layer for
            timed pool sessions: bounded target/source configuration
            transactions with independent readback, controlled protocol
            stop/reconfigure/start, live target verification before the first
            target-mining grant, initial health monitoring, and verified
            source restoration. Board 601 / BM1370 only. Disabled by default.

            This is a SECOND, independent safety flag: NX_TIMED_SESSIONS may
            stay enabled while this stays disabled, in which case Gate B6
            remains a hold-only runtime - no pool configuration write, no
            protocol verification connection, no controlled reconnect, no
            target-mining grant, no restart, and no B7 executor or singleton
            exists at all.

            Session creation over HTTP remains out of scope even with this
            flag enabled (Gate B8 owns the API surface). Leave disabled
            for production.

    config NX_TIMED_SESSIONS_API
        bool "Timed pool session HTTP control API (EXPERIMENTAL, Gate B8)"
        depends on NX_TIMED_SESSIONS && NX_TIMED_SESSIONS_EXECUTION
        default n
        help
            EXPERIMENTAL. Enables the Gate B8 timed-session control-plane API:
            a sanitized read-only status route, bounded session creation,
            Restore Now, terminal acknowledgement, and the standardized
            HTTP 409 conflict body for the existing pool PATCH / restart /
            OTA ownership fences. Board 601 / BM1370 only. Disabled by
            default and never auto-enabled.

            This is a THIRD, independent safety flag. HTTP handlers only
            VALIDATE requests and submit bounded commands to the single
            Gate B6 runtime owner task: no handler applies pool
            configuration, starts or stops Stratum, grants ASIC mining,
            restarts the device or writes the session store. No request may
            carry a password (Keep-current-password only), a source
            identity, a session id or a lease token, and no response
            exposes a pool host, account, worker, wallet, session id,
            generation or lease token.

            With this flag disabled no API route is registered, no command
            queue or API singleton exists and Gates B6/B7 behave exactly as
            committed. Leave disabled for production.

            The API is reachable only through the existing private-network
            admission check; it is NOT user-authenticated, and HTTP 409 is
            conflict reporting rather than access control. See
            docs/NEURALAXE_PHASE_2M1A_TIMED_POOL_SESSIONS_SECURITY.md.

    config NX_WEATHER_AWARE_TUNING
        bool "NeuralAxe Weather-Aware Tuning runtime (EXPERIMENTAL, Gate W4)"
        default n
        help
            EXPERIMENTAL. Compiles the default-disabled Weather-Aware Tuning
            convergence runtime (NeuralAxe Phase 2W, Gate W4), which joins the
            committed W1 profile/climate policy, W2 crash-safe persistence
            model, W3 weather client/scheduler and the committed Gate B2/B10
            trusted-time foundation into ONE bounded RECOMMENDATION.

            This flag is INDEPENDENT of every timed-session flag. It does not
            depend on, select or imply NX_TIMED_SESSIONS, the Gate B7
            execution flag, the Gate B8 API flag or the Gate B10 trusted-time
            observation flag, and it never turns any of them on.

            IT AUTHORIZES NOTHING. With it enabled the device still changes no
            frequency, no core voltage, no fan setting and no thermal limit;
            changes no pool configuration and no protocol behavior; acquires
            no operation lease; creates, restores or ends no timed session;
            grants no ASIC mining; registers no HTTP route; and never
            restarts. The runtime's only output is a bounded recommendation
            value that contains no executable command and no function pointer.
            Applying a recommendation to hardware requires a separate,
            explicit, future execution gate that does not exist yet.

            NO SECOND TIME PROVIDER. The weather runtime never initializes
            SNTP, never writes a trusted-time anchor and never reads a raw
            wall clock. It consumes trusted time only through an injected
            PoolTimeClock that its integrator owns. Without one it reports a
            bounded WAITING_FOR_TRUSTED_TIME state and evaluates no policy -
            it never falls back to time(), gettimeofday() or Stratum ntime.

            NO SOURCE AND NO LOCATION ARE BAKED IN. The weather provider
            defaults to UNCONFIGURED and the coordinates default to unset, so
            no network request can be composed; no weather hostname, URL,
            coordinate or API key exists in the firmware. Selecting a provider
            and a location is an explicit future configuration action, and the
            Gate W0 distribution decision is still unresolved.

            With this flag disabled the weather runtime is not built into the
            application, no weather symbol is linked, no task is created, the
            nx_wtp namespace is never opened and behavior is byte-for-byte
            unchanged. Leave disabled for production.

    config NX_WEATHER_SOURCE_POLICY
        bool "NeuralAxe weather private source policy (EXPERIMENTAL, Gate W5)"
        depends on NX_WEATHER_AWARE_TUNING
        default n
        help
            EXPERIMENTAL. Compiles the Gate W5 private source policy, which
            decides WHETHER a weather source may be used and, if so, WHICH
            provider and WHERE. It decides nothing else.

            IT AUTHORIZES NOTHING BEYOND A RECOMMENDATION. Everything the
            Gate W4 flag already forbids stays forbidden: no frequency,
            voltage, fan or thermal change; no pool or protocol change; no
            timed session, lease or execution; no SNTP start; no HTTP route;
            no task; no restart.

            NOTHING IS IMPLICIT. Every symbol below defaults to "not
            selected", so enabling this flag alone still yields an
            unconfigured device that issues no request. There is no default
            provider, no default location and no default timezone.

            PRIVATE VALUES NEVER LIVE IN THE REPOSITORY. Supply them through
            an out-of-tree sdkconfig fragment produced by
            tools/pilot/build_weather_recommendation_pilot.py, which reads
            them from the environment, never prints them, and deletes the
            fragment afterwards. The tracked defaults stay unconfigured.

    if NX_WEATHER_SOURCE_POLICY

    choice NX_WEATHER_DISTRIBUTION
        prompt "Weather distribution mode"
        default NX_WEATHER_DIST_UNSPECIFIED
        help
            Which distribution this deployment is, which decides whether an
            external weather source may be contacted at all. Only
            OWNER_MANAGED_EXTERNAL permits a provider.

    config NX_WEATHER_DIST_UNSPECIFIED
        bool "Unspecified (default; permits nothing)"

    config NX_WEATHER_DIST_DISABLED
        bool "Disabled (explicitly switched off)"

    config NX_WEATHER_DIST_OWNER_MANAGED_EXTERNAL
        bool "Owner-managed external source"
        help
            The owner explicitly supplies the source configuration, NeuralAxe
            infers neither location nor provider, the source is not reachable
            through the unauthenticated timed-session API, and the owner is
            responsible for the selected external service and its terms.

    endchoice

    choice NX_WEATHER_PROVIDER
        prompt "Weather provider"
        default NX_WEATHER_PROVIDER_NONE
        help
            The provider is an explicit capability, never an implicit
            selection. Gate W5 supports exactly one, the committed Gate W3
            Open-Meteo adapter, and adds no other.

    config NX_WEATHER_PROVIDER_NONE
        bool "None (default; no provider selected)"

    config NX_WEATHER_PROVIDER_OPEN_METEO
        bool "Open-Meteo (committed Gate W3 adapter)"

    endchoice

    choice NX_WEATHER_TIMEZONE
        prompt "Weather local timezone"
        default NX_WEATHER_TZ_NONE
        help
            The timezone used to convert trusted UTC to the local evaluation
            window. It is NOT a location: it never implies coordinates and is
            never used as a location proxy.

    config NX_WEATHER_TZ_NONE
        bool "None (default; no timezone selected)"

    config NX_WEATHER_TZ_EUROPE_BRUSSELS
        bool "Europe/Brussels (committed Gate W3 implementation)"

    endchoice

    config NX_WEATHER_LATITUDE_E4
        int "Weather latitude (degrees x 1e4)"
        range -900000 900000
        default 0
        help
            PRIVATE. Signed degrees scaled by 1e4, matching the committed W2
            record and W3 request parameters. 0 together with longitude 0 is
            the repository's "unset" sentinel and is rejected, so leaving
            this at the default keeps the device unconfigured. Never commit a
            real value; supply it through the pilot helper's environment.

    config NX_WEATHER_LONGITUDE_E4
        int "Weather longitude (degrees x 1e4)"
        range -1800000 1800000
        default 0
        help
            PRIVATE. See the latitude help text. Never commit a real value.

    config NX_WEATHER_RECOMMENDATION_PILOT_DIAGNOSTICS
        bool "NeuralAxe weather recommendation-only pilot diagnostics (Gate W6)"
        default n
        help
            EXPERIMENTAL, OWNER-SUPERVISED PILOT ONLY. Compiles bounded,
            read-only diagnostics for a recommendation-only weather pilot:
            edge-triggered state events, a once-per-minute summary, and a
            read-only invariant monitor.

            IT OBSERVES AND REPORTS ONLY. It creates no task, timer, queue or
            HTTP endpoint, writes no NVS and persists nothing. An invariant
            violation is reported and nothing else happens: the diagnostics
            never restart, never clear state, never change mining and never
            authorize an execution.

            EVERY LINE IS BOUNDED MACHINE TOKENS. No coordinate, city,
            timezone, provider hostname, request URL, forecast body, NTP
            server, pool identity or session identifier can appear — the
            diagnostic line type has no field that could hold one.

            Leave disabled for production. It is meaningful only in an
            owner-built pilot image together with the weather flags above.

    config NX_WEATHER_IO_WORKER
        bool "NeuralAxe asynchronous weather I/O worker (Gate W6.3)"
        depends on NX_WEATHER_RECOMMENDATION_PILOT_DIAGNOSTICS
        default n
        help
            EXPERIMENTAL, OWNER-SUPERVISED PILOT ONLY. Creates the ONE
            execution context in which the committed Gate W3 HTTPS weather
            transport may run.

            WHY IT EXISTS. The committed W3 transport is synchronous, and its
            8 s bound is an esp_http_client SOCKET timeout that applies to each
            blocking operation (connect/TLS, header fetch, every body read),
            not to the call as a whole. One fetch can therefore occupy tens of
            seconds. The weather pilot is stepped from the ~1 s statistics
            task, which must never perform DNS, TCP, TLS, HTTP or parsing of
            network data. This flag adds a single low-priority worker task so
            that work happens somewhere else.

            EXACTLY ONE OF EVERYTHING. One statically allocated task (guarded
            module-wide so repeated starts cannot duplicate it), one request
            slot, one result slot, one in-flight fetch. No queue grows, no
            allocation happens per request, and a wedged worker cannot latch
            the pilot busy: the deadline is enforced by the submitter, and a
            late result is discarded on its generation.

            IT ADDS NO AUTHORITY. No tuning execution, no frequency, voltage,
            fan, pool or protocol change, no restart, no persistence, no NVS
            namespace, no HTTP route, no second transport, no second scheduler
            and no second trusted-time provider. Recommendations remain
            recommendations: executed stays false.

            Leave disabled for production. Enabling it makes real outbound
            HTTPS requests to the configured weather provider possible, so it
            belongs only in an owner-built pilot image.

    config NX_WEATHER_IO_WORKER_STACK
        int "Weather I/O worker stack (bytes)"
        depends on NX_WEATHER_IO_WORKER
        range 8192 24576
        default 12288
        help
            Stack for the single weather I/O worker task.

            The peak consumer is the mbedTLS handshake reached through
            esp_crt_bundle_attach (certificate chain parsing and signature
            verification), not the HTTP or parsing code. The 12288 default is a
            deliberately conservative margin over the 8192 used by the other
            NeuralAxe tasks; it is NOT a measured value.

            The worker reports its stack high-water mark in the pilot
            diagnostics on every observation. Read that number from a
            supervised pilot before treating this size as proven, and tighten
            it with that evidence rather than by assumption.

    endif

    config NX_MUTATION_OBSERVABILITY
        bool "NeuralAxe authoritative mutation observability (Gate W6.1)"
        default n
        help
            EXPERIMENTAL, OWNER-SUPERVISED PILOT ONLY. Compiles saturating
            read-only counters at the CONFIGURATION MUTATION BOUNDARIES owned
            by each subsystem, so a recommendation-only pilot can prove that
            weather changed no configuration.

            IT OBSERVES ONLY. No task, timer, queue, HTTP endpoint, persistent
            storage or logging, and no behaviour change at any instrumented
            boundary. With it disabled every increment compiles away and the
            image contains no observability symbol or RAM object.

            CONFIGURATION, NOT ACTIVITY. Normal fan PWM control, the boot
            frequency ramp, the initial voltage application, pool reconnects
            on unchanged configuration, protocol state transitions and
            trusted-time synchronisation are NOT counted: the boundary is the
            persistent-configuration writer, which runtime activity never
            reaches. Only an accepted EFFECTIVE change to stored configuration
            counts, plus an explicit restart request and an accepted OTA.

            Independently default-disabled: it is useful together with the
            Gate W6 pilot diagnostics but depends on no other flag. With it
            off, the default image contains ZERO symbols and ZERO bytes of
            static RAM from this component - verified by an ELF symbol audit,
            not asserted.

endmenu
```
